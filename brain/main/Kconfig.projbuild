## brain/main/Kconfig.projbuild
```kconfig
menu "Brain OTA"

    config BRAIN_OTA_SKIP_MARK_VALID
        bool "Skip marking the image valid (rollback test)"
        default n
        help
            Leave the image in PENDING_VERIFY instead of calling
            esp_ota_mark_app_valid_cancel_rollback() once Ethernet has an IP.
            It runs until the next reset, which makes the bootloader roll
            back to the previous slot. While pending it refuses new uploads.
            Build it in its own build dir with sdkconfig.skip_mark_valid
            (docs/testing/bench/brain-ota.md).

endmenu
```

## components/node_reset/Kconfig
```kconfig
menu "Node reset line"

    config NODE_RESET_GPIO
        int "Brain GPIO driving the node's reset (EN)"
        range 0 48
        default 3
        help
            The brain GPIO wired to the node's EN through an inverting stage:
            HIGH holds the node in reset, LOW lets it run. Firmware on the
            brain drives it LOW from boot (node_reset_release()).

endmenu
```

## examples/bench_app/main/Kconfig.projbuild
```kconfig
menu "Bench App"

    config BENCH_APP_SKIP_MARK_VALID
        bool "Skip marking the image valid (rollback test)"
        default n
        help
            Leave the image in PENDING_VERIFY instead of calling
            esp_ota_mark_app_valid_cancel_rollback(). It runs once; the next
            reset makes the bootloader roll it back, which lands the board in
            the CAN updater. Build it in its own build dir with
            sdkconfig.skip_mark_valid (docs/bench-test.md).

    config BENCH_APP_CRASH_LOOP
        bool "Abort after confirming the image (crash-loop recovery test)"
        depends on !BENCH_APP_SKIP_MARK_VALID
        default n
        help
            Marks the image valid, then aborts after two seconds on every boot.
            Build in crash/ with sdkconfig.crash_loop (docs/bench-test.md).

endmenu
```

## examples/node_app/main/Kconfig.projbuild
```kconfig
menu "Node app CAN"

    config NODE_APP_TWAI_TX_GPIO
        int "TWAI TX GPIO (to transceiver TXD)"
        range 0 48
        default 4
        help
            Must match the TX pin the updater uses: the board profile in
            cancfg, or GPIO4 when the board has none. The app and the
            updater share one transceiver.

    config NODE_APP_TWAI_RX_GPIO
        int "TWAI RX GPIO (from transceiver RXD)"
        range 0 48
        default 5
        help
            Must match the updater's RX pin (board profile, or GPIO5).

    config NODE_APP_CAN_BITRATE_BPS
        int "CAN bitrate (bit/s)"
        default 250000
        help
            Must match the node updater and the brain (250000 on the bench).
            can_link accepts 10k, 20k, 50k, 100k, 125k, 250k, 500k and 1M.

endmenu
```

## examples/slcan_bridge/main/Kconfig.projbuild
```kconfig
menu "SLCAN Bridge"

    config SLCAN_BRIDGE_TWAI_TX_GPIO
        int "TWAI TX GPIO (to transceiver TXD)"
        range 0 48
        default 6
        help
            GPIO driving the CAN transceiver's TXD (TCAN332 D) on the brain.
            Avoid GPIO3 (the node's EN line), strapping pins (0, 45, 46),
            USB (19, 20), the flash/PSRAM pins (26-37 on octal-PSRAM modules)
            and UART0 (43, 44), which carries this firmware's log.

    config SLCAN_BRIDGE_TWAI_RX_GPIO
        int "TWAI RX GPIO (from transceiver RXD)"
        range 0 48
        default 7
        help
            GPIO reading the CAN transceiver's RXD (TCAN332 R). Same pin
            constraints as the TX GPIO.

    choice SLCAN_BRIDGE_BITRATE
        prompt "CAN bitrate until the host sends Sn"
        default SLCAN_BRIDGE_BITRATE_250K
        help
            The bitrate an `O` opens with when no `Sn` came first. python-can
            sends `Sn` whenever it is given a bitrate (can-flash always passes
            --bitrate, default 250000 = S5), which overrides this.

        config SLCAN_BRIDGE_BITRATE_125K
            bool "125 kbit/s"
        config SLCAN_BRIDGE_BITRATE_250K
            bool "250 kbit/s"
        config SLCAN_BRIDGE_BITRATE_500K
            bool "500 kbit/s"
        config SLCAN_BRIDGE_BITRATE_1M
            bool "1 Mbit/s"
    endchoice

    config SLCAN_BRIDGE_BITRATE_BPS
        int
        default 125000 if SLCAN_BRIDGE_BITRATE_125K
        default 250000 if SLCAN_BRIDGE_BITRATE_250K
        default 500000 if SLCAN_BRIDGE_BITRATE_500K
        default 1000000 if SLCAN_BRIDGE_BITRATE_1M

endmenu
```

## node_updater/main/Kconfig.projbuild
```kconfig
menu "CAN Updater"

    config CAN_UPDATER_TWAI_TX_GPIO
        int "TWAI TX GPIO (to transceiver TXD)"
        range 0 48
        default 4
        help
            GPIO driving the external 3.3 V CAN transceiver's TXD input. TWAI
            is routed through the GPIO matrix, so any free output-capable pin
            works. Avoid strapping pins (0, 3, 45, 46), USB (19, 20), the
            flash/PSRAM pins (26-37 on octal-PSRAM modules) and UART0 (43, 44).

    config CAN_UPDATER_TWAI_RX_GPIO
        int "TWAI RX GPIO (from transceiver RXD)"
        range 0 48
        default 5
        help
            GPIO reading the external CAN transceiver's RXD output. Same pin
            constraints as the TX GPIO.

    choice CAN_UPDATER_BITRATE
        prompt "CAN bitrate"
        default CAN_UPDATER_BITRATE_250K
        help
            Must match the host (can_flash.py --bitrate, default 250000).

        config CAN_UPDATER_BITRATE_125K
            bool "125 kbit/s"
        config CAN_UPDATER_BITRATE_250K
            bool "250 kbit/s"
        config CAN_UPDATER_BITRATE_500K
            bool "500 kbit/s"
        config CAN_UPDATER_BITRATE_1M
            bool "1 Mbit/s"
    endchoice

    config CAN_UPDATER_BITRATE_BPS
        int
        default 125000 if CAN_UPDATER_BITRATE_125K
        default 250000 if CAN_UPDATER_BITRATE_250K
        default 500000 if CAN_UPDATER_BITRATE_500K
        default 1000000 if CAN_UPDATER_BITRATE_1M

endmenu
```
